## app/Kconfig
```kconfig
#
# For a description of the syntax of this configuration file,
# see the file kconfig-language.txt in the NuttX tools repository.
#

config HEARTBEAT_DAEMON
	tristate "Heartbeat led"
	default n
	---help---
		Enable the Heartbeat led

if HEARTBEAT_DAEMON

config HEARTBEAT_DAEMON_PROGNAME
	string "Program name"
	default "heartbeat_daemon"
	---help---
		This is the name of the program that will be used when the NSH ELF
		program is installed.

config HEARTBEAT_DAEMON_PRIORITY
	int "Heartbeat daemon task priority"
	default 100

config HEARTBEAT_DAEMON_STACKSIZE
	int "Heartbeat daemon stack size"
	default DEFAULT_TASK_STACKSIZE

endif 
```

## board/Kconfig
```kconfig
#
# For a description of the syntax of this configuration file,
# see the file kconfig-language.txt in the NuttX tools repository.
#

config ARCH_BOARD_WEACT_STM32H750
	bool "WeAct Studio STM32H750 Board"
	depends on ARCH_CHIP_STM32H750VB
	select ARCH_HAVE_LEDS
	select ARCH_HAVE_BUTTONS
	select ARCH_HAVE_IRQBUTTONS

if ARCH_BOARD_WEACT_STM32H750

endif # ARCH_BOARD_WEACT_STM32H750
```

## modules/heartbeat_daemon/Kconfig
```kconfig
#
# For a description of the syntax of this configuration file,
# see the file kconfig-language.txt in the NuttX tools repository.
#

config MODULES_HEARTBEAT_DAEMON
	tristate "Heartbeat led"
	default n
	---help---
		Enable the Heartbeat led

if MODULES_HEARTBEAT_DAEMON

config MODULES_HEARTBEAT_DAEMON_PROGNAME
	string "Program name"
	default "heartbeat_daemon"
	---help---
		This is the name of the program that will be used when the NSH ELF
		program is installed.

config MODULES_HEARTBEAT_DAEMON_PRIORITY
	int "Heartbeat daemon task priority"
	default 100

config MODULES_HEARTBEAT_DAEMON_STACKSIZE
	int "Heartbeat daemon stack size"
	default DEFAULT_TASK_STACKSIZE

endif 
```

## modules/heartbeatd/Kconfig
```kconfig
config MODULES_HEARTBEATD
	tristate "Heartbeat led"
	default n
	---help---
		Enable the Heartbeat led

if MODULES_HEARTBEATD

config MODULES_HEARTBEATD_PROGNAME
	string "Program name"
	default "heartbeatd"
	---help---
		This is the name of the program that will be used when the NSH ELF
		program is installed.

config MODULES_HEARTBEATD_PRIORITY
	int "Heartbeatd task priority"
	default 100

config MODULES_HEARTBEATD_STACKSIZE
	int "Heartbeatd stack size"
	default DEFAULT_TASK_STACKSIZE

endif
```

## modules/webmorda/Kconfig
```kconfig
config MODULES_WEBMORDA
	tristate "Webmorda"
	default n
	---help---
		Enable the webmorda module

if MODULES_WEBMORDA

config MODULES_WEBMORDA_PROGNAME
	string "Program name"
	default "webmorda"
	---help---
		This is the name of the program that will be used when the NSH ELF
		program is installed.

config MODULES_WEBMORDA_PRIORITY
	int "Webmorda task priority"
	default 100

config MODULES_WEBMORDA_STACKSIZE
	int "Webmorda stack size"
	default 8192

endif
```

## modules/websocket/Kconfig
```kconfig
config MODULES_WEBSOCKET
	tristate "Websocket"
	default n
	---help---
		Enable the websocket module

if MODULES_WEBSOCKET

config MODULES_WEBSOCKET_PROGNAME
	string "Program name"
	default "websocket"
	---help---
		This is the name of the program that will be used when the NSH ELF
		program is installed.

config MODULES_WEBSOCKET_PRIORITY
	int "Websocket task priority"
	default 100

config MODULES_WEBSOCKET_STACKSIZE
	int "Websocket stack size"
	default 4096

endif
```
